## main/Kconfig.projbuild
```kconfig
menu "BitCat Watch (reloj 8 bits + clima por BLE)"

    config APP_BLE_NAME
        string "Nombre BLE del dispositivo"
        default "BITCAT WATCH v1"
        help
            Con este nombre aparece el reloj al buscarlo desde el celular.
            El firmware le agrega los ultimos dos bytes de la MAC (" A3F2"), de
            modo que dos unidades con el mismo binario se distinguen solas.
            Maximo 18 caracteres: con el sufijo son 23, el limite del paquete
            de anuncio. Si te pasas se anuncia recortado.

    config APP_IMU_INT_GPIO
        int "GPIO del pin INT del MPU-6050 (-1 = sin sensor)"
        default -1
        range -1 20
        help
            El MPU-6050 va en el mismo bus I2C que el OLED (0x68 contra 0x3C),
            asi que solo hace falta soldar VCC, GND, SDA, SCL y este pin.

            4 = pin D3 de la XIAO, que queda libre. -1 desactiva el sensor y no
            compila nada de esto.

            Con el sensor puesto la pantalla se apaga sola y se enciende al mover
            el reloj, que es lo que de verdad ahorra bateria y lo unico que frena
            el desgaste del OLED de raiz.

    config APP_IMU_ADDR
        hex "Direccion I2C del MPU-6050"
        default 0x68
        depends on APP_IMU_INT_GPIO >= 0
        help
            0x68 con AD0 a masa (lo habitual), 0x69 con AD0 a 3V3.

    config APP_IMU_UMBRAL
        int "Umbral de movimiento"
        default 20
        range 1 255
        depends on APP_IMU_INT_GPIO >= 0
        help
            Cuanto movimiento hace falta para despertar la pantalla. Mas bajo es
            mas sensible. Hay que afinarlo con el reloj puesto: 20 es un punto de
            partida, no un valor medido.

    config APP_IMU_DURACION_MS
        int "Milisegundos que debe durar el movimiento"
        default 20
        range 1 255
        depends on APP_IMU_INT_GPIO >= 0
        help
            Filtra los golpes sueltos. Subelo si la pantalla se enciende sola
            sobre la mesa.

    config APP_SCREEN_TIMEOUT_S
        int "Segundos de inactividad antes de apagar el OLED"
        default 8 if APP_IMU_INT_GPIO >= 0
        default 0
        range 0 3600
        help
            0 = la pantalla nunca se apaga.
            Con el MPU-6050 puesto conviene un valor corto: el sensor la vuelve
            a encender al mover el reloj, asi que apagarla no molesta.
            Con cualquier otro valor el panel se apaga solo tras ese tiempo sin
            tocar el boton, y vuelve al presionarlo. Con la pantalla apagada el
            reloj sigue contando y recibiendo por BLE.

    config APP_OLED_CONTRAST
        int "Brillo del OLED en reposo (0-255)"
        default 48
        range 1 255
        help
            El registro de contraste del SSD1306 es corriente de segmento, de
            donde sale casi todo el consumo del panel. A 48 se ve bien en
            interiores y gasta cerca de una cuarta parte que a 207, que era el
            valor anterior. Tambien reparte el desgaste del OLED, que importa
            con la pantalla encendida de forma permanente.

    config APP_OLED_CONTRAST_SUN
        int "Brillo al pulsar el boton (0-255)"
        default 255
        range 1 255
        help
            Al tocar el boton estas mirando la pantalla, asi que se sube al
            maximo durante unos segundos. Es lo que la hace legible en exteriores
            sin pagar ese brillo las 24 horas.

    config APP_OLED_SUN_S
        int "Segundos que dura el brillo alto"
        default 15
        range 0 300
        help
            Cada pulsacion reinicia la cuenta. 0 desactiva la subida y deja
            siempre el brillo de reposo.

    config APP_LIGHT_SLEEP
        bool "Light sleep automatico"
        default y
        help
            Baja el CPU a 80 MHz y deja que el chip duerma entre eventos.
            Desactivalo si necesitas 'idf.py monitor' estable: la consola por
            USB no sobrevive bien al light sleep.

    config APP_BUTTON_GPIO
        int "GPIO del boton que alterna las vistas"
        default 0
        help
            0 = boton BOOT de la XIAO ESP32-S3 (a GND, con pull-up interno).
            Si conectas un boton propio, tambien debe ir a GND.

    config APP_BATTERY_GPIO
        int "GPIO del divisor de bateria (-1 = sin indicador)"
        default -1
        range -1 20
        help
            La XIAO ESP32-S3 carga el LiPo pero no trae forma de medirlo: la
            wiki de Seeed dice que ningun GPIO llega al pin de bateria. Hay que
            soldar un divisor de dos resistencias de 100k entre B+ y GND, con el
            punto medio a un pin de ADC1.

            1 = pin A0 de la XIAO. -1 desactiva el indicador y no compila nada
            de esto, que es lo que quieres si todavia no has soldado.

    config APP_BATTERY_DIVISOR_X100
        int "Relacion del divisor, multiplicada por 100"
        default 200
        range 100 1000
        depends on APP_BATTERY_GPIO >= 0
        help
            200 = dos resistencias iguales, o sea el voltaje se divide entre 2.
            Si usas otras, pon (R1+R2)/R2 por 100.

    config APP_I2C_SCL_GPIO
        int "GPIO de SCL"
        default 6
        help
            6 = pin D5 de la XIAO ESP32-S3 (SCL de fabrica).

    config APP_I2C_SDA_GPIO
        int "GPIO de SDA"
        default 5
        help
            5 = pin D4 de la XIAO ESP32-S3 (SDA de fabrica).

    config APP_OLED_ADDR
        hex "Direccion I2C del OLED"
        default 0x3C
        help
            0x3C en casi todos los modulos SSD1306; algunos usan 0x3D.

    config APP_OLED_HEIGHT
        int "Alto del panel en pixeles"
        default 32
        help
            32 para el modulo de 0.91", 64 para los de 0.96" / 1.3".
            El layout de la pantalla esta hecho para 128x32.

endmenu
```
